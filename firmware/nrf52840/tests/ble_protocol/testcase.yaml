## firmware/nrf52840/tests/ble_protocol/testcase.yaml
```yaml
tests:
  tinycardia.ble_protocol:
    platform_allow:
      - native_sim/native/64
    integration_platforms:
      - native_sim/native/64
    tags:
      - ble
      - protocol
      - unit
```

## firmware/nrf52840/tests/ecg_processing/testcase.yaml
```yaml
tests:
  tinycardia.ecg_processing:
    platform_allow:
      - native_sim/native/64
    integration_platforms:
      - native_sim/native/64
    tags:
      - ecg
      - processing
      - unit
```

## firmware/nrf52840/tests/ecg_processor/Kconfig
```kconfig
# SPDX-License-Identifier: MIT

mainmenu "Tinycardia ECG processor tests"

config TINYCARDIA_ECG_THREAD_STACK_SIZE
	int
	default 4096

config TINYCARDIA_ECG_THREAD_PRIORITY
	int
	default 5

source "Kconfig.zephyr"
```

## firmware/nrf52840/tests/ecg_processor/testcase.yaml
```yaml
tests:
  tinycardia.ecg_processor:
    platform_allow:
      - native_sim/native/64
    integration_platforms:
      - native_sim/native/64
    tags:
      - ecg
      - processing
      - concurrency
      - unit
```

## firmware/nrf52840/tests/model_inference/testcase.yaml
```yaml
tests:
  tinycardia.model_inference:
    platform_allow:
      - native_sim/native/64
    integration_platforms:
      - native_sim/native/64
    timeout: 120
    tags:
      - inference
      - model
      - unit
```
